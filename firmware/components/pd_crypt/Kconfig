## firmware/components/pd_crypt/Kconfig
```kconfig
menu "DataDrive encryption"

    config PD_CRYPT_SELFTEST
        bool "AES-256-XTS self-test at boot (IEEE P1619 vectors)"
        default y
        help
            Checks both AES-XTS implementations against known answers (and against each other
            across 20 sectors) before the drive can be unlocked or set up, and logs the crypto
            throughput. Takes a few milliseconds. If the direct hardware path fails, mbedtls is
            used; if both fail, encryption is refused. Off: only one known-answer test of the
            path in use (always run).

    config PD_CRYPT_HW_DIRECT
        bool "Drive the AES peripheral directly (fast path)"
        default y
        help
            mbedtls' XTS starts one DMA transfer per 16-byte block (33 per sector). The direct
            path uses the AES peripheral in register mode under the same hardware lock and loads
            each key once per 16 sectors. Off: mbedtls only.

    config PD_CRYPT_SCRATCH_KB
        int "Encryption write buffer (KiB, allocated only while unlocked)"
        default 8
        range 1 32
        help
            Writes are encrypted into this buffer (never in the caller's buffer). 8 KiB matches
            the USB MSC transfer size; larger values mean fewer, longer SD card writes for
            uploads at the cost of heap.

    config PD_CRYPT_KDF_TARGET_MS
        int "Target time of the password key derivation (ms)"
        default 2000
        range 500 5000
        help
            PBKDF2-HMAC-SHA256 iterations are calibrated at setup / password change so that one
            derivation takes about this long on the device (fastest of 5 probes; never less
            than half a second's worth). Unlocking takes about this long, too.

    config PD_CRYPT_OVERWRITE_MAX_MB
        int "Overwrite fallback limit when the medium cannot be erased (MB)"
        default 64
        range 0 100000
        help
            Setup erases the whole medium (SD ERASE command, flash erase). If a card refuses
            ERASE, the affected sectors are overwritten with zeros instead, up to this amount;
            beyond it setup is refused, because overwriting a large card takes hours.

endmenu
```

## firmware/components/pd_wifi/Kconfig
```kconfig
menu "DataDrive Wi-Fi"

    config PD_WIFI_HOSTNAME
        string "Default hostname (DHCP and mDNS)"
        default "datadrive"
        help
            The web interface is reachable as http://<hostname>.local where mDNS works.
            Default only: the hostname can be changed in the web UI (stored in NVS) and goes
            back to this value when the button is held for 10 s. Use 1-31 characters a-z,
            0-9 and '-' (not first or last); anything else falls back to "datadrive".

    config PD_WIFI_AP_FALLBACK_S
        int "Start setup access point after this many seconds without connection"
        default 20
        range 5 600

    config PD_WIFI_AP_LINGER_S
        int "Keep setup access point on for this many seconds after the station connected"
        default 120
        range 10 3600

    config PD_WIFI_CAPTIVE_PORTAL
        bool "Captive portal on the setup access point"
        default y
        help
            While the setup access point is on, a small DNS responder answers every name with
            the access point's address, so phones and laptops open the setup page by themselves
            (the web server redirects their connectivity checks). Costs no task and no socket.

    config PD_WIFI_CAPTIVE_DHCP_URI
        bool "Announce the setup page via DHCP option 114 (RFC 8910)"
        depends on PD_WIFI_CAPTIVE_PORTAL
        default y
        help
            Sends http://<ap-ip>/ as captive portal URI. iOS and Android only use this option
            with an https URL and otherwise fall back to their connectivity checks; switch it
            off if a client misbehaves with it.

endmenu
```

## firmware/printdrive/main/Kconfig.projbuild
```kconfig
menu "DataDrive"

    config PD_HOST_WRITABLE_DEFAULT
        bool "USB host may write to the drive (default; changeable in the web UI)"
        default y
        help
            Needed for phase 1 tests on Windows (copy files to the drive). For the
            printer a read-only drive is safer: the host can then never damage the
            file system and the drive can always be taken back for uploads.

    config PD_BOOT_WAIT_HOST_MS
        int "At boot, wait this long for a USB host before staying in upload mode"
        default 3000
        range 0 20000

    config PD_PROVIDE_ON_ATTACH
        bool "Provide the drive automatically when a USB host connects"
        default y

    config PD_EJECT_TO_APP
        bool "Switch to upload mode automatically when the host ejects the drive"
        default y

    config PD_REPLUG_ON_PROVIDE
        bool "Always re-enumerate (soft unplug/replug) when providing the drive"
        default y
        help
            Makes the host treat the drive like a freshly inserted USB stick. Without
            it, only a SCSI "medium changed" notification is sent (unless the host had
            ejected the drive, then a re-plug is always done).

    config PD_HOST_WRITE_GUARD_MS
        int "Never take the drive from the host within this time after its last write (ms)"
        default 3000
        range 500 60000

    config PD_USE_SDCARD
        bool "Use a microSD card as storage if one is inserted (else internal flash)"
        default y
        help
            The card is never formatted automatically. Cards with exFAT (typically > 32 GB)
            must be formatted to FAT32 via the web UI, because ESP-IDF's FatFs has no exFAT.

    config PD_FAT_CLUSTER_KB
        int "FAT cluster size in KiB used when formatting (2 or 4)"
        default 4
        range 2 4
        help
            4: web uploads write whole 4 KiB flash sectors (about 6x faster than 2 KiB),
               but the ~11 MB volume becomes FAT12.
            2: FAT16 (more common), but web uploads are slow (each cluster write is a
               partial flash sector). Only applied when the storage is (re)formatted.

    config PD_UPLOAD_ALL_TYPES
        bool "Accept uploads of any file type"
        default y
        help
            Off: only .3mf (and optionally .gcode) may be uploaded. The content check for
            .3mf files (must be a complete ZIP) applies in both cases.

    config PD_ALLOW_GCODE
        bool "Also accept .gcode uploads (in addition to .3mf)"
        depends on !PD_UPLOAD_ALL_TYPES
        default n

    config PD_HTTPS_OPTION
        bool "Offer HTTPS as a switchable option (experimental)"
        default y
        help
            The web UI then offers HTTPS as a switch (off until the user turns it on).
            Measured on the T-Dongle-S3 (no PSRAM) with 0.5.0, encrypted drive unlocked:
            30 MB upload 864 kB/s, download 389 kB/s, 66 KiB heap free when idle, lowest
            22 KiB during the upload, no TLS buffer misses. The record buffers are reserved
            once at start (tls.c) and only one TLS connection is served at a time.
            Residual risk of the single connection: any device in the LAN (no login needed)
            can occupy the HTTPS server - a stalled handshake for up to 3 s per attempt, or
            request headers sent very slowly (esp_http_server has no total header deadline,
            only the 10 s per-receive timeout) - and so make the web UI unresponsive for as
            long as it keeps doing that. It cannot read or change anything. A second
            connection would need a second reserved buffer pair (~21 KiB), which the heap
            does not allow (22 KiB lowest during an upload). Plain HTTP has the same
            exposure with more sockets; the USB drive itself is never affected.

    config PD_OTA_SIGNED
        bool "Accept only signed firmware updates over the web UI (RSA-3072)"
        default n
        depends on !SECURE_BOOT
        select SECURE_SIGNED_APPS_NO_SECURE_BOOT
        select SECURE_SIGNED_ON_UPDATE_NO_SECURE_BOOT
        help
            Turns on ESP-IDF's "signed app verification without hardware secure boot"
            (Secure Boot V2 signature block, RSA-3072 / RSA-PSS, the only scheme the
            ESP32-S3 offers). POST /api/ota then installs an image only if it is signed
            with the same key as the running firmware; esp_ota_end() checks this before
            the boot partition is switched, so a refused image never replaces the
            running firmware.

            The image built with this option MUST be signed (the release build signs it
            during the build, see tools/signing/README.md). An unsigned image built with
            this option aborts at start ("This app is not signed..."): over the web the
            bootloader then rolls back, over USB it needs a new USB flash.

            Off in the repository (sdkconfig.defaults) so that every clone builds and
            flashes without a key. The owner's release build turns it on through the
            overlay sdkconfig.signed (tools/signing/build_signed.ps1).

            Not protected: flashing over USB (physical access), no hardware secure boot,
            no flash encryption. See docs/17_signierte_updates.md.

endmenu
```
